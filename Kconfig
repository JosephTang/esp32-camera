## Kconfig
```kconfig
menu "Camera configuration"

    choice CAMERA_DEVICE_CHOICE
        bool "I2C peripheral to use for SCCB"
        default OV7670_SUPPORT

        config OV7670_SUPPORT
            bool "OV7670 VGA"
        config OV7725_SUPPORT
            bool "OV7725 SVGA"
        config NT99141_SUPPORT
            bool "NT99141 HD"
        config OV2640_SUPPORT
            bool "OV2640 2MP"
        config OV3660_SUPPORT
            bool "OV3660 3MP"
        config OV5640_SUPPORT
            bool "OV5640 5MP"
        config GC0328_SUPPORT
            bool "GC0328 VGA"
        config BF2013_SUPPORT
            bool "BF2013 VGA"
    endchoice

    config SCCB_HARDWARE_INSTALL_I2C_DRIVER
        bool "Install I2C driver when SCCB init"
        default y

    choice SCCB_HARDWARE_I2C_PORT
        bool "I2C peripheral to use for SCCB"
        default SCCB_HARDWARE_I2C_PORT1

        config SCCB_HARDWARE_I2C_PORT0
            bool "I2C0"
        config SCCB_HARDWARE_I2C_PORT1
            bool "I2C1"

    endchoice

    choice CAMERA_TASK_PINNED_TO_CORE
        bool "Camera task pinned to core"
        default CAMERA_CORE0
        help
            Pin the camera handle task to a certain core(0/1). It can also be done automatically choosing NO_AFFINITY.

        config CAMERA_CORE0
            bool "CORE0"
        config CAMERA_CORE1
            bool "CORE1"
        config CAMERA_NO_AFFINITY
            bool "NO_AFFINITY"

    endchoice

endmenu
```
